## drivers/mxc/Kconfig
```kconfig
# drivers/video/mxc/Kconfig

if ARCH_MXC

menu "MXC support drivers"

config MXC_IPU
	bool "Image Processing Unit Driver"
	depends on !ARCH_MX21
	depends on !ARCH_MX27
	depends on !ARCH_MX25
	select MXC_IPU_V1 if !ARCH_MX37 && !ARCH_MX5
	select MXC_IPU_V3 if ARCH_MX37 || ARCH_MX5
	select MXC_IPU_V3D if ARCH_MX37
	select MXC_IPU_V3EX if ARCH_MX5
	help
	  If you plan to use the Image Processing unit, say
	  Y here. IPU is needed by Framebuffer and V4L2 drivers.

source "drivers/mxc/ipu3/Kconfig"

source "drivers/mxc/pmic/Kconfig"

endmenu

endif
```

## drivers/video/eink/Kconfig
```kconfig
#
# eInk configuration
#

config FB_EINK_LIBRARY
    bool "eInk Built-in Library"
    select FB_CFB_FILLRECT
    select FB_CFB_COPYAREA
    select FB_CFB_IMAGEBLIT
    select FB_SYS_FILLRECT
    select FB_SYS_COPYAREA
    select FB_SYS_IMAGEBLIT
    select FB_SYS_FOPS
    select ZLIB_INFLATE
    select ZLIB_DEFLATE
    select PROC_BOOTDATA
    default y

config FB_EINK
    tristate "eInk Umbrella Config (HAL, Waveform, Legacy Shim)"
    depends on FB

config FB_EINK_WAVEFORM
    tristate "eink Waveform Header Parser"
    depends on FB

config FB_EINK_LEGACY
    tristate "eInk Legacy Config for Shim"
    depends on FB_EINK

config FB_EINK_SHIM
    tristate "eink Shim Driver (Legacy-to-HAL Bridge)"
    depends on FB_EINK
    
config FB_EINK_HAL
    tristate "eink HAL Umbrella Config"
    depends on FB_EINK

config FB_EINK_HAL_EMULATOR
    tristate "eInk HAL Driver for the Emulator"
    depends on FB_EINK_HAL

config FB_EINK_HAL_FSLEPDC
    tristate "eInk HAL Driver for the FSL EPDC"
    depends on FB_EINK_HAL && ARCH_MXC && FB_MXC_EINK_PANEL
```
